## west.yml
```yaml
manifest:
  remotes:
    - name: zmkfirmware
      url-base: https://github.com/zmkfirmware
    - name: moon0440
      url-base: https://github.com/blakemoon

  projects:
    - name: zmk
      remote: zmkfirmware
      revision: main
      import: app/west.yml

    - name: zmk-urchin-module
      remote: moon0440
      revision: main
      path: modules/zmk-urchin-module

  self:
    path: config
```
